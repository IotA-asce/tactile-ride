## CMakeLists.txt
```
# SPDX-License-Identifier: Apache-2.0

cmake_minimum_required(VERSION 3.20.0)
find_package(Zephyr REQUIRED HINTS $ENV{ZEPHYR_BASE})
project(tactile_ride_ble_hid_poc)

target_sources(app PRIVATE
  src/main.c
  src/ble_connection.c
  src/button_input.c
  src/button_logic.c
  src/consumer_report.c
  src/hid_service.c
  src/media_controller.c
  src/power_policy.c
)

target_include_directories(app PRIVATE include)
```

## Kconfig
```
mainmenu "TactileRide Phase 1"

source "Kconfig.zephyr"

menu "TactileRide Phase 1"

config TACTILE_RIDE_DEBOUNCE_MS
	int "Input debounce interval in milliseconds"
	range 1 1000
	default 30
	help
	  Consecutive raw samples must remain unchanged for this interval before a
	  logical press or release is emitted.

config TACTILE_RIDE_VOLUME_REPEAT_DELAY_MS
	int "Held-volume repeat delay in milliseconds"
	range 1 10000
	default 400
	help
	  Delay after the debounced volume press before repeat begins.

config TACTILE_RIDE_VOLUME_REPEAT_INTERVAL_MS
	int "Held-volume repeat interval in milliseconds"
	range 100 10000
	default 250
	help
	  Interval between held-volume actions. The default caps repeat to four
	  actions per second.

config TACTILE_RIDE_DEV_AUTO_DEMO
	bool "Enable development-only synthetic input demo"
	default n
	help
	  Generate a repeating sequence through the normal input abstraction. This
	  is disabled by default and must not be treated as a physical-control test.

config TACTILE_RIDE_DEV_AUTO_DEMO_INTERVAL_MS
	int "Development demo delay after each release in milliseconds"
	depends on TACTILE_RIDE_DEV_AUTO_DEMO
	range 100 60000
	default 2000

endmenu
```

## prj.conf
```kconfig
CONFIG_BT=y
CONFIG_BT_PERIPHERAL=y
CONFIG_BT_SMP=y
CONFIG_BT_BONDABLE=y
CONFIG_BT_SETTINGS=y
CONFIG_BT_MAX_CONN=1
CONFIG_BT_DEVICE_NAME="TactileRide POC"
CONFIG_BT_DEVICE_APPEARANCE=960

CONFIG_FLASH=y
CONFIG_FLASH_MAP=y
CONFIG_NVS=y
CONFIG_SETTINGS=y

CONFIG_LOG=y
CONFIG_LOG_DEFAULT_LEVEL=3
CONFIG_MAIN_STACK_SIZE=2048
CONFIG_SYSTEM_WORKQUEUE_STACK_SIZE=2048
```

## src/main.c
```c
#include <errno.h>

#include <zephyr/logging/log.h>
#include <zephyr/sys/util.h>

#include <tactile_ride/ble_connection.h>
#include <tactile_ride/button_input.h>
#include <tactile_ride/button_logic.h>
#include <tactile_ride/hid_service.h>
#include <tactile_ride/media_controller.h>
#include <tactile_ride/power_policy.h>

LOG_MODULE_REGISTER(tactile_app, LOG_LEVEL_INF);

static struct button_logic button_logic[MEDIA_ACTION_COUNT];
static struct media_controller media_controller;

static bool transport_is_ready(void *context)
{
	ARG_UNUSED(context);
	return ble_connection_is_connected() && hid_service_notifications_enabled();
}

static int transport_send_input_report(void *context, uint8_t report)
{
	ARG_UNUSED(context);
	return hid_service_send_input_report(report);
}

static void handle_button_sample(enum media_action action, bool raw_pressed,
				 uint32_t now_ms)
{
	enum button_event_type event;
	int err;

	if (action >= MEDIA_ACTION_COUNT) {
		LOG_WRN("Ignoring unknown input action %d", action);
		return;
	}

	event = button_logic_update(&button_logic[action], raw_pressed, now_ms);
	if (event != BUTTON_EVENT_PRESSED && event != BUTTON_EVENT_REPEAT) {
		return;
	}

	err = media_controller_trigger(&media_controller, action);
	if (err == -ENOTCONN) {
		LOG_INF("Dropped action %d: no connected subscribed HID host", action);
	} else if (err != 0) {
		LOG_WRN("Action %d failed (%d)", action, err);
	} else {
		LOG_INF("Sent action %d%s", action,
			event == BUTTON_EVENT_REPEAT ? " (repeat)" : "");
	}
}

int main(void)
{
	const struct media_transport transport = {
		.is_ready = transport_is_ready,
		.send_input_report = transport_send_input_report,
		.context = NULL,
	};
	int err;

	for (enum media_action action = MEDIA_ACTION_VOLUME_INCREMENT;
	     action < MEDIA_ACTION_COUNT; action++) {
		button_logic_init(&button_logic[action], action,
				  CONFIG_TACTILE_RIDE_DEBOUNCE_MS,
				  CONFIG_TACTILE_RIDE_VOLUME_REPEAT_DELAY_MS,
				  CONFIG_TACTILE_RIDE_VOLUME_REPEAT_INTERVAL_MS);
	}

	err = media_controller_init(&media_controller, &transport);
	if (err != 0) {
		LOG_ERR("Media controller init failed (%d)", err);
		return 0;
	}

	hid_service_init();
	power_policy_init();

	err = ble_connection_start();
	if (err != 0) {
		LOG_ERR("BLE connection setup failed (%d)", err);
		return 0;
	}

	err = button_input_start(handle_button_sample);
	if (err != 0) {
		LOG_ERR("Button input init failed (%d)", err);
	}

	return 0;
}
```

## src/ble_connection.c
```c
#include <errno.h>

#include <zephyr/bluetooth/bluetooth.h>
#include <zephyr/bluetooth/conn.h>
#include <zephyr/bluetooth/hci.h>
#include <zephyr/bluetooth/uuid.h>
#include <zephyr/logging/log.h>
#include <zephyr/settings/settings.h>

#include <tactile_ride/ble_connection.h>

LOG_MODULE_REGISTER(tactile_ble, LOG_LEVEL_INF);

static struct bt_conn *active_connection;

static const struct bt_data advertising_data[] = {
	BT_DATA_BYTES(BT_DATA_FLAGS, BT_LE_AD_GENERAL | BT_LE_AD_NO_BREDR),
	BT_DATA_BYTES(BT_DATA_UUID16_ALL, BT_UUID_16_ENCODE(BT_UUID_HIDS_VAL)),
};

static const struct bt_data scan_response_data[] = {
	BT_DATA(BT_DATA_NAME_COMPLETE, CONFIG_BT_DEVICE_NAME,
		sizeof(CONFIG_BT_DEVICE_NAME) - 1),
};

static int start_advertising(void)
{
	int err;

	err = bt_le_adv_start(BT_LE_ADV_CONN_FAST_1, advertising_data,
			      ARRAY_SIZE(advertising_data), scan_response_data,
			      ARRAY_SIZE(scan_response_data));
	if (err != 0) {
		LOG_ERR("Advertising start failed (%d)", err);
		return err;
	}

	LOG_INF("Advertising BLE HID Consumer Control service");
	return 0;
}

static void connected(struct bt_conn *conn, uint8_t err)
{
	char address[BT_ADDR_LE_STR_LEN];
	int security_err;

	bt_addr_le_to_str(bt_conn_get_dst(conn), address, sizeof(address));
	if (err != 0U) {
		LOG_WRN("Connection to %s failed (0x%02x)", address, err);
		return;
	}

	if (active_connection != NULL) {
		bt_conn_unref(active_connection);
	}
	active_connection = bt_conn_ref(conn);
	LOG_INF("Connected to %s", address);

	security_err = bt_conn_set_security(conn, BT_SECURITY_L2);
	if (security_err != 0 && security_err != -EALREADY) {
		LOG_WRN("Encryption request failed (%d)", security_err);
	}
}

static void disconnected(struct bt_conn *conn, uint8_t reason)
{
	char address[BT_ADDR_LE_STR_LEN];

	bt_addr_le_to_str(bt_conn_get_dst(conn), address, sizeof(address));
	LOG_INF("Disconnected from %s (0x%02x)", address, reason);

	if (active_connection == conn) {
		bt_conn_unref(active_connection);
		active_connection = NULL;
	}

	(void)start_advertising();
}

static void security_changed(struct bt_conn *conn, bt_security_t level,
			     enum bt_security_err err)
{
	char address[BT_ADDR_LE_STR_LEN];

	bt_addr_le_to_str(bt_conn_get_dst(conn), address, sizeof(address));
	if (err == BT_SECURITY_ERR_SUCCESS) {
		LOG_INF("Security level %u established with %s", level, address);
	} else {
		LOG_WRN("Security change for %s failed (%d)", address, err);
	}
}

BT_CONN_CB_DEFINE(tactile_connection_callbacks) = {
	.connected = connected,
	.disconnected = disconnected,
	.security_changed = security_changed,
};

int ble_connection_start(void)
{
	int err;

	err = bt_enable(NULL);
	if (err != 0) {
		LOG_ERR("Bluetooth init failed (%d)", err);
		return err;
	}

	if (IS_ENABLED(CONFIG_SETTINGS)) {
		err = settings_load();
		if (err != 0) {
			LOG_WRN("Bond settings load failed (%d)", err);
		}
	}

	return start_advertising();
}

bool ble_connection_is_connected(void)
{
	return active_connection != NULL;
}

int ble_connection_reset_bonds(void)
{
	LOG_WRN("Bond reset has no safe runtime trigger in Phase 1");
	return -ENOTSUP;
}
```

## src/button_input.c
```c
#include <errno.h>

#include <zephyr/kernel.h>
#include <zephyr/logging/log.h>
#include <zephyr/sys/util.h>

#include <tactile_ride/button_input.h>

LOG_MODULE_REGISTER(tactile_input, LOG_LEVEL_INF);

#define DEV_POLL_INTERVAL_MS 10U
#define DEV_NON_VOLUME_HOLD_MS 100U
#define DEV_VOLUME_HOLD_MS 950U

static button_input_callback_t input_callback;

#if defined(CONFIG_TACTILE_RIDE_DEV_AUTO_DEMO) && CONFIG_TACTILE_RIDE_DEV_AUTO_DEMO
static struct k_work_delayable demo_work;
static enum media_action demo_action;
static bool demo_pressed;
static uint32_t demo_phase_started_ms;

static bool elapsed(uint32_t now_ms, uint32_t then_ms, uint32_t interval_ms)
{
	return (uint32_t)(now_ms - then_ms) >= interval_ms;
}

static void demo_work_handler(struct k_work *work)
{
	uint32_t now_ms = k_uptime_get_32();
	uint32_t hold_ms;

	ARG_UNUSED(work);
	hold_ms = media_action_is_volume(demo_action) ? DEV_VOLUME_HOLD_MS :
		  DEV_NON_VOLUME_HOLD_MS;

	if (demo_pressed && elapsed(now_ms, demo_phase_started_ms, hold_ms)) {
		demo_pressed = false;
		demo_phase_started_ms = now_ms;
	} else if (!demo_pressed && elapsed(now_ms, demo_phase_started_ms,
				       CONFIG_TACTILE_RIDE_DEV_AUTO_DEMO_INTERVAL_MS)) {
		demo_action = (enum media_action)((demo_action + 1) % MEDIA_ACTION_COUNT);
		demo_pressed = true;
		demo_phase_started_ms = now_ms;
	}

	input_callback(demo_action, demo_pressed, now_ms);
	k_work_schedule(&demo_work, K_MSEC(DEV_POLL_INTERVAL_MS));
}
#endif

int button_input_start(button_input_callback_t callback)
{
	if (callback == NULL) {
		return -EINVAL;
	}

	input_callback = callback;

#if defined(CONFIG_TACTILE_RIDE_DEV_AUTO_DEMO) && CONFIG_TACTILE_RIDE_DEV_AUTO_DEMO
	demo_action = MEDIA_ACTION_VOLUME_INCREMENT;
	demo_pressed = true;
	demo_phase_started_ms = k_uptime_get_32();
	k_work_init_delayable(&demo_work, demo_work_handler);
	k_work_schedule(&demo_work, K_NO_WAIT);
	LOG_WRN("Development-only synthetic input demo enabled");
#else
	LOG_INF("No physical GPIO input is configured for Phase 1");
#endif

	return 0;
}
```

## src/button_logic.c
```c
#include <stddef.h>

#include <tactile_ride/button_logic.h>

static bool debounce_elapsed(uint32_t now_ms, uint32_t then_ms, uint32_t interval_ms)
{
	return (uint32_t)(now_ms - then_ms) >= interval_ms;
}

static bool deadline_reached(uint32_t now_ms, uint32_t deadline_ms)
{
	return (int32_t)(now_ms - deadline_ms) >= 0;
}

void button_logic_init(struct button_logic *logic, enum media_action action,
		       uint32_t debounce_ms, uint32_t repeat_delay_ms,
		       uint32_t repeat_interval_ms)
{
	if (logic == NULL) {
		return;
	}

	*logic = (struct button_logic){
		.action = action,
		.debounce_ms = debounce_ms,
		.repeat_delay_ms = repeat_delay_ms,
		.repeat_interval_ms = repeat_interval_ms,
	};
}

enum button_event_type button_logic_update(struct button_logic *logic,
					   bool raw_pressed, uint32_t now_ms)
{
	if (logic == NULL) {
		return BUTTON_EVENT_NONE;
	}

	if (raw_pressed != logic->candidate_pressed) {
		logic->candidate_pressed = raw_pressed;
		logic->candidate_since_ms = now_ms;
	}

	if (logic->stable_pressed != logic->candidate_pressed &&
	    debounce_elapsed(now_ms, logic->candidate_since_ms, logic->debounce_ms)) {
		logic->stable_pressed = logic->candidate_pressed;

		if (logic->stable_pressed) {
			if (media_action_is_volume(logic->action)) {
				logic->next_repeat_ms = now_ms + logic->repeat_delay_ms;
			}
			return BUTTON_EVENT_PRESSED;
		}

		return BUTTON_EVENT_RELEASED;
	}

	if (logic->stable_pressed && media_action_is_volume(logic->action) &&
	    deadline_reached(now_ms, logic->next_repeat_ms)) {
		logic->next_repeat_ms = now_ms + logic->repeat_interval_ms;
		return BUTTON_EVENT_REPEAT;
	}

	return BUTTON_EVENT_NONE;
}
```

## src/consumer_report.c
```c
#include <errno.h>
#include <stddef.h>

#include <tactile_ride/consumer_report.h>

int consumer_report_press(enum media_action action, uint8_t *report)
{
	if (report == NULL) {
		return -EINVAL;
	}

	switch (action) {
	case MEDIA_ACTION_VOLUME_INCREMENT:
		*report = CONSUMER_REPORT_VOLUME_INCREMENT;
		return 0;
	case MEDIA_ACTION_VOLUME_DECREMENT:
		*report = CONSUMER_REPORT_VOLUME_DECREMENT;
		return 0;
	case MEDIA_ACTION_PLAY_PAUSE:
		*report = CONSUMER_REPORT_PLAY_PAUSE;
		return 0;
	case MEDIA_ACTION_NEXT_TRACK:
		*report = CONSUMER_REPORT_NEXT_TRACK;
		return 0;
	case MEDIA_ACTION_PREVIOUS_TRACK:
		*report = CONSUMER_REPORT_PREVIOUS_TRACK;
		return 0;
	case MEDIA_ACTION_COUNT:
		return -EINVAL;
	}

	return -EINVAL;
}

void consumer_report_release(uint8_t *report)
{
	if (report != NULL) {
		*report = CONSUMER_REPORT_RELEASE;
	}
}
```

## src/hid_service.c
```c
#include <errno.h>
#include <string.h>

#include <zephyr/bluetooth/gatt.h>
#include <zephyr/bluetooth/uuid.h>
#include <zephyr/logging/log.h>

#include <tactile_ride/hid_service.h>

LOG_MODULE_REGISTER(tactile_hids, LOG_LEVEL_INF);

enum {
	HIDS_REMOTE_WAKE = BIT(0),
	HIDS_NORMALLY_CONNECTABLE = BIT(1),
	HIDS_INPUT = 0x01,
	HIDS_INPUT_REPORT_ATTRIBUTE_INDEX = 5,
};

struct hids_info {
	uint16_t version;
	uint8_t country_code;
	uint8_t flags;
} __packed;

struct hids_report_reference {
	uint8_t id;
	uint8_t type;
} __packed;

static const struct hids_info hids_info = {
	.version = 0x0111,
	.country_code = 0x00,
	.flags = HIDS_NORMALLY_CONNECTABLE,
};

static const struct hids_report_reference input_report_reference = {
	.id = 0x01,
	.type = HIDS_INPUT,
};

/*
 * Report ID 1 contains one Consumer Page input byte:
 * bit 0 Volume Increment (0xE9), bit 1 Volume Decrement (0xEA),
 * bit 2 Play/Pause (0xCD), bit 3 Scan Next Track (0xB5), and
 * bit 4 Scan Previous Track (0xB6). Bits 5-7 are constant padding.
 */
static const uint8_t consumer_report_map[] = {
	0x05, 0x0c, /* Usage Page (Consumer) */
	0x09, 0x01, /* Usage (Consumer Control) */
	0xa1, 0x01, /* Collection (Application) */
	0x85, 0x01, /*   Report ID (1) */
	0x15, 0x00, /*   Logical Minimum (0) */
	0x25, 0x01, /*   Logical Maximum (1) */
	0x75, 0x01, /*   Report Size (1) */
	0x95, 0x05, /*   Report Count (5) */
	0x09, 0xe9, /*   Usage (Volume Increment) */
	0x09, 0xea, /*   Usage (Volume Decrement) */
	0x09, 0xcd, /*   Usage (Play/Pause) */
	0x09, 0xb5, /*   Usage (Scan Next Track) */
	0x09, 0xb6, /*   Usage (Scan Previous Track) */
	0x81, 0x02, /*   Input (Data, Variable, Absolute) */
	0x75, 0x03, /*   Report Size (3) */
	0x95, 0x01, /*   Report Count (1) */
	0x81, 0x03, /*   Input (Constant, Variable, Absolute) */
	0xc0,       /* End Collection */
};

static uint8_t last_input_report;
static bool notifications_enabled;
static uint8_t control_point;

static ssize_t read_hids_info(struct bt_conn *conn, const struct bt_gatt_attr *attr,
			      void *buf, uint16_t len, uint16_t offset)
{
	return bt_gatt_attr_read(conn, attr, buf, len, offset, attr->user_data,
				 sizeof(hids_info));
}

static ssize_t read_report_map(struct bt_conn *conn, const struct bt_gatt_attr *attr,
			       void *buf, uint16_t len, uint16_t offset)
{
	return bt_gatt_attr_read(conn, attr, buf, len, offset, consumer_report_map,
				 sizeof(consumer_report_map));
}

static ssize_t read_input_report(struct bt_conn *conn, const struct bt_gatt_attr *attr,
				 void *buf, uint16_t len, uint16_t offset)
{
	return bt_gatt_attr_read(conn, attr, buf, len, offset, &last_input_report,
				 sizeof(last_input_report));
}

static ssize_t read_report_reference(struct bt_conn *conn, const struct bt_gatt_attr *attr,
				     void *buf, uint16_t len, uint16_t offset)
{
	return bt_gatt_attr_read(conn, attr, buf, len, offset, attr->user_data,
				 sizeof(input_report_reference));
}

static ssize_t write_control_point(struct bt_conn *conn, const struct bt_gatt_attr *attr,
				   const void *buf, uint16_t len, uint16_t offset,
				   uint8_t flags)
{
	if (offset + len > sizeof(control_point)) {
		return BT_GATT_ERR(BT_ATT_ERR_INVALID_OFFSET);
	}

	memcpy(&control_point + offset, buf, len);
	return len;
}

static void input_ccc_changed(const struct bt_gatt_attr *attr, uint16_t value)
{
	notifications_enabled = value == BT_GATT_CCC_NOTIFY;
	LOG_INF("Consumer input notifications %s",
		notifications_enabled ? "enabled" : "disabled");
}

BT_GATT_SERVICE_DEFINE(tactile_hids_service,
	BT_GATT_PRIMARY_SERVICE(BT_UUID_HIDS),
	BT_GATT_CHARACTERISTIC(BT_UUID_HIDS_INFO, BT_GATT_CHRC_READ, BT_GATT_PERM_READ,
			       read_hids_info, NULL, (void *)&hids_info),
	BT_GATT_CHARACTERISTIC(BT_UUID_HIDS_REPORT_MAP, BT_GATT_CHRC_READ,
			       BT_GATT_PERM_READ, read_report_map, NULL, NULL),
	BT_GATT_CHARACTERISTIC(BT_UUID_HIDS_REPORT, BT_GATT_CHRC_READ | BT_GATT_CHRC_NOTIFY,
			       BT_GATT_PERM_READ_ENCRYPT, read_input_report, NULL, NULL),
	BT_GATT_CCC(input_ccc_changed, BT_GATT_PERM_READ_ENCRYPT | BT_GATT_PERM_WRITE_ENCRYPT),
	BT_GATT_DESCRIPTOR(BT_UUID_HIDS_REPORT_REF, BT_GATT_PERM_READ, read_report_reference,
			   NULL, (void *)&input_report_reference),
	BT_GATT_CHARACTERISTIC(BT_UUID_HIDS_CTRL_POINT, BT_GATT_CHRC_WRITE_WITHOUT_RESP,
			       BT_GATT_PERM_WRITE, NULL, write_control_point, &control_point),
);

void hid_service_init(void)
{
	LOG_INF("Consumer Control HID service ready (report ID 1)");
}

bool hid_service_notifications_enabled(void)
{
	return notifications_enabled;
}

int hid_service_send_input_report(uint8_t report)
{
	int err;

	if (!notifications_enabled) {
		return -EACCES;
	}

	last_input_report = report;
	err = bt_gatt_notify(NULL,
			     &tactile_hids_service.attrs[HIDS_INPUT_REPORT_ATTRIBUTE_INDEX],
			     &last_input_report, sizeof(last_input_report));
	if (err != 0) {
		LOG_WRN("Consumer report notification failed (%d)", err);
	}

	return err;
}
```

## src/media_controller.c
```c
#include <errno.h>
#include <stddef.h>

#include <tactile_ride/consumer_report.h>
#include <tactile_ride/media_controller.h>

int media_controller_init(struct media_controller *controller,
			  const struct media_transport *transport)
{
	if (controller == NULL || transport == NULL || transport->is_ready == NULL ||
	    transport->send_input_report == NULL) {
		return -EINVAL;
	}

	controller->transport = *transport;
	return 0;
}

int media_controller_trigger(struct media_controller *controller,
			     enum media_action action)
{
	uint8_t report;
	int err;

	if (controller == NULL) {
		return -EINVAL;
	}

	if (!controller->transport.is_ready(controller->transport.context)) {
		return -ENOTCONN;
	}

	err = consumer_report_press(action, &report);
	if (err != 0) {
		return err;
	}

	err = controller->transport.send_input_report(controller->transport.context, report);
	if (err != 0) {
		return err;
	}

	consumer_report_release(&report);
	return controller->transport.send_input_report(controller->transport.context, report);
}
```

## src/power_policy.c
```c
#include <zephyr/logging/log.h>

#include <tactile_ride/power_policy.h>

LOG_MODULE_REGISTER(tactile_power, LOG_LEVEL_INF);

void power_policy_init(void)
{
	LOG_INF("Power policy is intentionally inactive during the Phase 1 bench POC");
}
```
